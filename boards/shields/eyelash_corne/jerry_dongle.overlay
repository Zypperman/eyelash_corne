/*
 * Copyright (c) 2024 The ZMK Contributors
 *
 * SPDX-License-Identifier: MIT
 */

#include "eyelash_corne.dtsi"

/ {
    chosen {
        zmk,kscan = &mock_kscan;
        zephyr,display = &oled;
    };

    mock_kscan: mock_kscan_0 {
        compatible = "zmk,kscan-mock";
        columns = <0>;
        rows = <0>;
        events = <0>;
    };
};

/*
 * jerry_dongle has its own 1.3" 128x64 display, replacing the 0.91" 128x32
 * used on the halves. 1.3" 128x64 modules are SH1106-driven (132-col RAM,
 * centered 128-col window) even when sold as "SSD1306 compatible" - using
 * the ssd1306 driver on this panel shows shifted/garbled content because
 * SH1106 doesn't support ssd1306's horizontal addressing mode.
 */
&oled {
    compatible = "sinowealth,sh1106";
    /delete-property/ com-sequential;
    height = <64>;
    segment-offset = <2>;
    multiplex-ratio = <63>;
};
