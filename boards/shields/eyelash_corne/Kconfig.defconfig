## boards/shields/eyelash_corne/Kconfig.defconfig
```kconfig
if SHIELD_EYELASH_CORNE_LEFT

config ZMK_KEYBOARD_NAME
    default "Eyelash Corne"

config ZMK_SPLIT_ROLE_CENTRAL
    default y

endif


if SHIELD_JERRY_DONGLE

config ZMK_KEYBOARD_NAME
    default "Eyelash Corne"

config ZMK_SPLIT_ROLE_CENTRAL
    default y

config ZMK_SPLIT_BLE_CENTRAL_PERIPHERALS
    default 2

config BT_MAX_CONN
    default 7

config BT_MAX_PAIRED
    default 7

endif


if SHIELD_EYELASH_CORNE_LEFT || SHIELD_EYELASH_CORNE_RIGHT || SHIELD_JERRY_DONGLE

config ZMK_SPLIT
    default y


if ZMK_DISPLAY

config I2C
    default y

config SSD1306
    default y

choice ZMK_DISPLAY_WORK_QUEUE
    default ZMK_DISPLAY_WORK_QUEUE_DEDICATED
endchoice

endif

if SSD1306

config LV_Z_VDB_SIZE
    default 64

config LV_DPI_DEF
    default 148

config LV_Z_BITS_PER_PIXEL
    default 1

choice LV_COLOR_DEPTH
    default LV_COLOR_DEPTH_1
endchoice

endif

if ZMK_BACKLIGHT

config PWM
    default y

config LED_PWM
    default y

endif # ZMK_BACKLIGHT

endif
```

## boards/shields/eyelash_corne/Kconfig.shield
```kconfig
# Copyright (c) 2020 The ZMK Contributors
# SPDX-License-Identifier: MIT
config SHIELD_EYELASH_CORNE_LEFT
    def_bool $(shields_list_contains,eyelash_corne_left)

config SHIELD_EYELASH_CORNE_RIGHT
    def_bool $(shields_list_contains,eyelash_corne_right)

config SHIELD_JERRY_DONGLE
    def_bool $(shields_list_contains,jerry_dongle)
```

## boards/shields/jerry/Kconfig.shield
```kconfig
# No whitespace after the comma or in the keyboard name!
config SHIELD_JERRY_DONGLE
    def_bool $(shields_list_contains,jerry)
```

## config/west.yml
```yaml
manifest:
  remotes:
    - name: zmkfirmware
      url-base: https://github.com/zmkfirmware
    - name: mctechnology17
      url-base: https://github.com/mctechnology17
    - name: urob
      url-base: https://github.com/urob
    - name: englmaxi
      url-base: https://github.com/englmaxi
      # Additional modules containing boards/shields/custom code can be listed here as well.
      # See:
      # - https://zmk.dev/docs/features/modules
      # - https://docs.zephyrproject.org/3.5.0/develop/west/manifest.html#projects
  projects:
    - name: zmk
      remote: zmkfirmware
      revision: v0.3.0
      import: app/west.yml
    - name: zmk-nice-oled
      remote: mctechnology17
      revision: main
    - name: zmk-board-eyelash
      url: https://github.com/a741725193/zmk-board-eyelash
      revision: main
    - name: zmk-helpers
      remote: urob
      revision: main
    - name: zmk-dongle-display
      remote: englmaxi
      revision: v0.3
  self:
    path: config
```

## dts/bindings/behaviors/zmk,behavior-scroll-kinetic.yaml
```yaml
# Copyright (c) 2026 The ZMK Contributors
# SPDX-License-Identifier: MIT

description: |
  Two axis scroll behavior with a QMK "kinetic speed" style curve: on press it
  jumps straight to initial-speed (sized so the very first trigger-period-ms
  tick already emits a whole scroll unit, i.e. no ramp-up lag on a tap), then
  linearly ramps to base-speed over time-to-base-ms for sustained holding.

compatible: "zmk,behavior-scroll-kinetic"

include: one_param.yaml

properties:
  x-input-code:
    type: int
    required: true
  y-input-code:
    type: int
    required: true
  trigger-period-ms:
    type: int
    default: 16
    description: Time (ms) between generated scroll reports while a direction is held. Mirrors QMK's MOUSEKEY_WHEEL_INTERVAL.
  delay-ms:
    type: int
    default: 0
    description: Time (ms) after press before scrolling starts. Mirrors QMK's MOUSEKEY_WHEEL_DELAY.
  initial-speed:
    type: int
    required: true
    description: Scroll speed (units/sec) used the instant the delay elapses. Mirrors QMK's MOUSEKEY_WHEEL_INITIAL_SPEED. Pick this so initial-speed * trigger-period-ms / 1000 >= 1 to guarantee a tap always registers immediately.
  base-speed:
    type: int
    required: true
    description: Steady-state scroll speed (units/sec) once time-to-base-ms has elapsed. Mirrors QMK's MOUSEKEY_WHEEL_BASE_SPEED.
  time-to-base-ms:
    type: int
    default: 0
    description: Time (ms) to linearly ramp from initial-speed to base-speed. 0 disables the ramp (base-speed applies immediately).
```
